## zthe_low_power/components/caps_ota/Kconfig.projbuild
```kconfig
menu "OTA Configuration"

    config FIRMWARE_SERVER_URL
        string "Firmware Service URL"
        default "http://caps-platform.live:3000/api/users/<userID>/ota/download/firmware/latest.bin"

    config OTA_TOKEN
        string "IoT Platform Token"
        help
            To create this token, please login with your credentials and download the token from your device.
            This token can be the same as the one for sending messages to the IoT Platform.

endmenu
  
```
